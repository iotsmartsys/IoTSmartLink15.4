## client_154/main/Kconfig.projbuild
```kconfig
menu "App Client"

choice IOTSMARTLINK154_PRODUCT_FIRMWARE
    prompt "Product firmware"
    default IOTSMARTLINK154_PRODUCT_SINGLE_SMART_PLUG
    help
        Selects the single product composed into this binary. The choice only
        picks which file under main/firmwares/ is compiled; it never enables
        product logic inside the shared ISSP components.

config IOTSMARTLINK154_PRODUCT_SINGLE_SMART_PLUG
    bool "Single smart plug"
    help
        One switchable power output on endpoint 1, with factory reset.

config IOTSMARTLINK154_PRODUCT_DOOR_SENSOR_BATTERY_H2
    bool "Door sensor battery H2"
    help
        One dry-contact input on endpoint 1, with factory reset. The product
        publishes event type 1 for open and closed transitions. Battery
        powered: it enables deep sleep and requires a board offering the
        wake_led, digital_input_wakeup and battery_measurement resources, waking
        both by the periodic timer and by a transition of the dry contact. It
        publishes battery level on endpoint 2 with event type 3.

config IOTSMARTLINK154_PRODUCT_PRESENCE_SENSOR_BATTERY_H2
    bool "Presence sensor battery H2"
    help
        Read-only presence on endpoint 1 (event type 5), battery level on
        endpoint 2 and battery telemetry state on endpoint 3. Requires the
        Battery Digital Sensor H2 board resources for the enabled features.

config IOTSMARTLINK154_PRODUCT_LIGHT_SENSOR_BATTERY_H2
    bool "Light sensor battery H2"
    depends on IDF_TARGET_ESP32H2
    help
        One direct ADC percentage report on endpoint 1 (event type 6) per boot.
        Always sleeps using a configurable timer, defaulting to 15 minutes.
        Requires a board offering light_measurement; no periodic ADC task.

endchoice

choice IOTSMARTLINK154_BOARD_MODEL
    prompt "Board model"
    default IOTSMARTLINK154_BOARD_CURRENT_CLIENT_ESP32H2_WIRING
    help
        Selects the board wiring compiled into this binary. Only board models
        compatible with the configured IDF_TARGET are offered; the menu never
        changes IDF_TARGET itself.

config IOTSMARTLINK154_BOARD_CURRENT_CLIENT_ESP32H2_WIRING
    bool "Current client ESP32-H2 wiring"
    depends on IDF_TARGET_ESP32H2
    help
        Descriptive identifier for the wiring currently used by the client_154
        prototype. Electrical details belong exclusively to the selected board
        source. Compatible with ESP32-H2 only.

config IOTSMARTLINK154_BOARD_BATTERY_DIGITAL_SENSOR_H2
    bool "Battery Digital Sensor H2"
    depends on IDF_TARGET_ESP32H2
    help
        Battery-powered ESP32-H2 digital sensor board. Electrical details belong
        exclusively to the selected board source.

config IOTSMARTLINK154_BOARD_LIGHT_SENSOR_H2
    bool "Light Sensor H2"
    depends on IDF_TARGET_ESP32H2
    help
        Confirmed 3.3 V LDR divider on GPIO2 with a 10 kohm resistor to GND.

endchoice

menu "Firmware features"
    depends on IOTSMARTLINK154_PRODUCT_DOOR_SENSOR_BATTERY_H2 || IOTSMARTLINK154_PRODUCT_PRESENCE_SENSOR_BATTERY_H2 || IOTSMARTLINK154_PRODUCT_LIGHT_SENSOR_BATTERY_H2

config IOTSMARTLINK154_ENABLE_DEEP_SLEEP
    bool "Enable deep sleep"
    default y
    depends on IOTSMARTLINK154_PRODUCT_DOOR_SENSOR_BATTERY_H2 || IOTSMARTLINK154_PRODUCT_PRESENCE_SENSOR_BATTERY_H2
    help
        Enables the product's periodic timer, digital-input wakeup and wake LED.

config IOTSMARTLINK154_MAX_AWAKE_TIME_SECONDS
    int "Maximum awake time (seconds)"
    default 30
    range 1 4294967
    depends on IOTSMARTLINK154_ENABLE_DEEP_SLEEP || IOTSMARTLINK154_PRODUCT_LIGHT_SENSOR_BATTERY_H2

config IOTSMARTLINK154_WAKEUP_INTERVAL_MINUTES
    int "Periodic wake-up interval (minutes)"
    default 180 if IOTSMARTLINK154_PRODUCT_PRESENCE_SENSOR_BATTERY_H2
    default 15
    range 1 2147483647
    depends on IOTSMARTLINK154_ENABLE_DEEP_SLEEP || IOTSMARTLINK154_PRODUCT_LIGHT_SENSOR_BATTERY_H2

config IOTSMARTLINK154_ENABLE_BATTERY_LEVEL
    bool "Enable battery level capability"
    default y
    depends on IOTSMARTLINK154_PRODUCT_DOOR_SENSOR_BATTERY_H2 || IOTSMARTLINK154_PRODUCT_PRESENCE_SENSOR_BATTERY_H2 || IOTSMARTLINK154_PRODUCT_LIGHT_SENSOR_BATTERY_H2

config IOTSMARTLINK154_BATTERY_READING_INTERVAL_MINUTES
    int "Battery reading interval (minutes)"
    default 120
    range 1 71582
    depends on IOTSMARTLINK154_ENABLE_BATTERY_LEVEL && !IOTSMARTLINK154_ENABLE_DEEP_SLEEP && !IOTSMARTLINK154_PRODUCT_LIGHT_SENSOR_BATTERY_H2

endmenu

menu "Board configuration"

config IOTSMARTLINK154_FACTORY_RESET_GPIO
    int "Factory reset GPIO"
    default 9
    range 0 27
    depends on IOTSMARTLINK154_PRODUCT_SINGLE_SMART_PLUG || IOTSMARTLINK154_PRODUCT_DOOR_SENSOR_BATTERY_H2 || IOTSMARTLINK154_PRODUCT_PRESENCE_SENSOR_BATTERY_H2

endmenu

endmenu
```
